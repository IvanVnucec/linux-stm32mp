// SPDX-License-Identifier: (GPL-2.0-or-later OR BSD-3-Clause)
/*
 * Copyright (C) STMicroelectronics 2022 - All Rights Reserved
 * Author: Alexandre Torgue <alexandre.torgue@foss.st.com> for STMicroelectronics.
 * Copyright (C) Emcraft Systems 2024 - All Rights Reserved
 */
/dts-v1/;

#include "stm32mp157.dtsi"
#include "stm32mp15xa.dtsi"
#include "stm32mp15-pinctrl.dtsi"
#include "stm32mp15xxaa-pinctrl.dtsi"
#include "stm32mp157a-som-scmi.dtsi"
#include "stm32mp157x-som.dtsi"

/ {
	model = "Emcraft STM32MP1 SOM Rev 1A";
	compatible = "emcraft,stm32mp1-som", "st,stm32mp157a-ev1", "st,stm32mp157";
};
