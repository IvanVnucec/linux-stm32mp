// SPDX-License-Identifier: (GPL-2.0-or-later OR BSD-3-Clause)
/*
 * Copyright (C) Emcraft Systems 2023-2024 - All Rights Reserved
 */
/dts-v1/;

#include "stm32mp157.dtsi"
#include "stm32mp15xd.dtsi"
#include "stm32mp15-pinctrl.dtsi"
#include "stm32mp15xxaa-pinctrl.dtsi"
#include "stm32mp157d-som-scmi.dtsi"
#include "stm32mp157x-som.dtsi"

/ {
	model = "Emcraft STM32MP157D SOM Rev 3A";
	compatible = "emcraft,stm32mp157d-som", "st,stm32mp157d-ev1", "st,stm32mp157";
};
